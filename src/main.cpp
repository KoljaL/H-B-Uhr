// Generated by Copilot
#include <Arduino.h>
#include <Preferences.h>
#include <WiFi.h>
#include "AiEsp32RotaryEncoder.h"
#include "web_server.h"

#ifndef WIFI_SSID
#define WIFI_SSID ""
#endif
#ifndef WIFI_PASSWORD
#define WIFI_PASSWORD ""
#endif
#ifndef STATIC_IP
#define STATIC_IP ""
#endif
#ifndef STATIC_GATEWAY
#define STATIC_GATEWAY ""
#endif
#ifndef STATIC_SUBNET
#define STATIC_SUBNET ""
#endif

constexpr int PIN_MINUTES = 14;
constexpr int PIN_HOURS = 13;
constexpr int PWM_FREQ = 500;
constexpr int PWM_RESOLUTION = 10;
constexpr int PWM_MAX = (1 << PWM_RESOLUTION) - 1;
constexpr int ENCODER_A_PIN = 26;
constexpr int ENCODER_B_PIN = 25;
constexpr int ENCODER_SW_PIN = 27;
constexpr int ENCODER_VCC_PIN = -1;
constexpr int ENCODER_STEPS = 4;
constexpr unsigned long WIFI_RECONNECT_INTERVAL_MS = 10000;
constexpr unsigned long WIFI_STARTUP_TIMEOUT_MS = 15000;
constexpr unsigned long BUTTON_DEBOUNCE_MS = 35;
constexpr unsigned long BUTTON_LONG_PRESS_MS = 1000;
constexpr char AP_SSID[] = "HB-Uhr-Setup";
constexpr char AP_PASSWORD[] = "hb-uhr-setup";

constexpr size_t CALIBRATION_POINTS = 13;
constexpr uint32_t CALIBRATION_VERSION = 1;

constexpr bool ENABLE_MOTION_PROFILE = true;
constexpr unsigned long MOTION_INTERVAL_MS_DEFAULT = 10;
constexpr int MOTION_ACCEL_DEFAULT = 8;
constexpr int MOTION_MAX_SPEED_DEFAULT = 20;
constexpr unsigned long MOTION_INTERVAL_MS_MAX = 1000;
constexpr int MOTION_ACCEL_MAX = PWM_MAX;
constexpr int MOTION_MAX_SPEED_MAX = PWM_MAX;

AiEsp32RotaryEncoder rotaryEncoder(
    ENCODER_A_PIN,
    ENCODER_B_PIN,
    ENCODER_SW_PIN,
    ENCODER_VCC_PIN,
    ENCODER_STEPS,
    false);

enum class OperatingMode : uint8_t
{
  Normal = 0,
  CalibrationMinutes = 1,
  CalibrationHours = 2
};

struct CalibrationData
{
  uint16_t minutes[CALIBRATION_POINTS];
  uint16_t hours[CALIBRATION_POINTS];
};

Preferences preferences;
CalibrationData calibration{};
OperatingMode operatingMode = OperatingMode::Normal;
uint8_t calibrationIndex = 0;
uint8_t dummyHour = 12;
uint8_t dummyMinute = 0;
int activeInstrument = 1;
int pwmMinutes = 0;
int pwmHours = 0;
bool motionProfileEnabled = ENABLE_MOTION_PROFILE;
unsigned long motionIntervalMs = MOTION_INTERVAL_MS_DEFAULT;
int motionAccel = MOTION_ACCEL_DEFAULT;
int motionMaxSpeed = MOTION_MAX_SPEED_DEFAULT;
int targetPwmMinutes = 0;
int targetPwmHours = 0;
int motionVelocityMinutes = 0;
int motionVelocityHours = 0;
unsigned long lastMotionUpdateAt = 0;
int lastEncoderValue = -1;
int lastDisplayedHour = -1;
int lastDisplayedMinute = -1;
unsigned long lastWifiCheck = 0;
unsigned long wifiStartTime = 0;
bool accessPointActive = false;
bool buttonWasPressed = false;
bool longPressHandled = false;
unsigned long buttonChangedAt = 0;
unsigned long buttonPressedAt = 0;

void IRAM_ATTR readEncoderISR()
{
  rotaryEncoder.readEncoder_ISR();
}

bool validPwm(int value)
{
  return value >= 0 && value <= PWM_MAX;
}

// Schreibt nur den PWM-Wert, ohne Ziel/Geschwindigkeit des Bewegungsprofils zu beeinflussen.
void applyPwm(int instrument, int value)
{
  const int pwmValue = constrain(value, 0, PWM_MAX);
  if (instrument == 1)
  {
    pwmMinutes = pwmValue;
    ledcWrite(PIN_MINUTES, pwmValue);
  }
  else if (instrument == 2)
  {
    pwmHours = pwmValue;
    ledcWrite(PIN_HOURS, pwmValue);
  }
}

// Fuer instante Direktschreibvorgaenge: PWM setzen und Bewegungsprofil-Ziel synchron halten.
void writeInstrument(int instrument, int value)
{
  applyPwm(instrument, value);
  if (instrument == 1)
  {
    targetPwmMinutes = pwmMinutes;
    motionVelocityMinutes = 0;
  }
  else if (instrument == 2)
  {
    targetPwmHours = pwmHours;
    motionVelocityHours = 0;
  }
}

// Trapezoidal-profile step: accelerates, cruises, then brakes to stop exactly at target.
int stepMotionAxis(int currentPos, int &velocity, int target)
{
  const int distance = target - currentPos;
  if (distance == 0)
  {
    velocity = 0;
    return currentPos;
  }

  const int direction = distance > 0 ? 1 : -1;
  const int distanceAbs = abs(distance);
  const int accel = max(1, motionAccel);
  int speedAbs = abs(velocity);
  const int brakingDistance = (speedAbs * speedAbs) / (2 * accel);

  if (distanceAbs <= brakingDistance || distanceAbs <= speedAbs)
    speedAbs = max(0, speedAbs - accel);
  else if (speedAbs < motionMaxSpeed)
    speedAbs = min(motionMaxSpeed, speedAbs + accel);

  if (speedAbs > distanceAbs)
    speedAbs = distanceAbs;

  velocity = direction * speedAbs;
  int nextPos = currentPos + velocity;

  if ((direction > 0 && nextPos >= target) || (direction < 0 && nextPos <= target))
  {
    nextPos = target;
    velocity = 0;
  }

  return nextPos;
}

void updateInstrumentMotion()
{
  if (!motionProfileEnabled)
    return;

  const unsigned long now = millis();
  if (now - lastMotionUpdateAt < motionIntervalMs)
    return;
  lastMotionUpdateAt = now;

  const int nextMinutes = stepMotionAxis(pwmMinutes, motionVelocityMinutes, targetPwmMinutes);
  if (nextMinutes != pwmMinutes)
    applyPwm(1, nextMinutes);

  const int nextHours = stepMotionAxis(pwmHours, motionVelocityHours, targetPwmHours);
  if (nextHours != pwmHours)
    applyPwm(2, nextHours);
}

// Live-Ausgaben respektieren das Bewegungsprofil statt es zu ueberschreiben, unabhaengig von der Betriebsart.
void driveInstrumentLive(int instrument, int value)
{
  const int pwmValue = constrain(value, 0, PWM_MAX);
  if (motionProfileEnabled)
  {
    if (instrument == 1)
      targetPwmMinutes = pwmValue;
    else if (instrument == 2)
      targetPwmHours = pwmValue;
  }
  else
  {
    writeInstrument(instrument, pwmValue);
  }
}

uint16_t interpolate(uint16_t start, uint16_t end, uint16_t numerator, uint16_t denominator)
{
  if (denominator == 0)
    return start;

  const int32_t difference = static_cast<int32_t>(end) - start;
  const int32_t result = static_cast<int32_t>(start) +
                         (difference * numerator) / denominator;
  return static_cast<uint16_t>(constrain(result, 0, PWM_MAX));
}

void initializeCalibration()
{
  memset(&calibration, 0, sizeof(calibration));
  const bool validVersion = preferences.getUInt("version", 0) == CALIBRATION_VERSION;
  const bool validMinutes = preferences.getBytesLength("minutes") == sizeof(calibration.minutes);
  const bool validHours = preferences.getBytesLength("hours") == sizeof(calibration.hours);

  if (validVersion && validMinutes && validHours)
  {
    preferences.getBytes("minutes", calibration.minutes, sizeof(calibration.minutes));
    preferences.getBytes("hours", calibration.hours, sizeof(calibration.hours));
    for (size_t index = 0; index < CALIBRATION_POINTS; ++index)
    {
      if (!validPwm(calibration.minutes[index]) || !validPwm(calibration.hours[index]))
      {
        memset(&calibration, 0, sizeof(calibration));
        Serial.println("[WARNUNG] Ungueltige Kalibrierwerte, starte mit 0.");
        return;
      }
    }
  }
  else
  {
    Serial.println("Keine gueltige Kalibrierung gefunden, starte mit 0.");
  }
}

void saveCalibration()
{
  preferences.putUInt("version", CALIBRATION_VERSION);
  preferences.putBytes("minutes", calibration.minutes, sizeof(calibration.minutes));
  preferences.putBytes("hours", calibration.hours, sizeof(calibration.hours));
}

uint16_t *activeCalibrationTable()
{
  return operatingMode == OperatingMode::CalibrationMinutes ? calibration.minutes : calibration.hours;
}

int activeCalibrationInstrument()
{
  return operatingMode == OperatingMode::CalibrationMinutes ? 1 : 2;
}

void showCalibrationPoint()
{
  activeInstrument = activeCalibrationInstrument();
  const uint16_t value = activeCalibrationTable()[calibrationIndex];
  writeInstrument(activeInstrument, value);
  rotaryEncoder.setEncoderValue(value);
  lastEncoderValue = value;
  Serial.printf("[KALIBRIERUNG] %s Punkt %u: PWM %u\n",
                operatingMode == OperatingMode::CalibrationMinutes ? "Minute" : "Stunde",
                calibrationIndex * (operatingMode == OperatingMode::CalibrationMinutes ? 5 : 1),
                value);
}

void applyNormalTime()
{
  if (operatingMode != OperatingMode::Normal)
    return;

  const uint8_t minuteIndex = dummyMinute / 5;
  const uint8_t minuteRemainder = dummyMinute % 5;
  const uint16_t minutePwm = interpolate(
      calibration.minutes[minuteIndex],
      calibration.minutes[minuteIndex + 1],
      minuteRemainder,
      5);

  const uint8_t hour12 = dummyHour % 12;
  const uint8_t hourIndex = dummyHour == 12 ? 12 : hour12;
  const uint8_t nextHourIndex = hourIndex == 12 ? 1 : hourIndex + 1;
  const uint16_t hourPwm = interpolate(
      calibration.hours[hourIndex],
      calibration.hours[nextHourIndex],
      dummyMinute,
      60);

  targetPwmMinutes = minutePwm;
  targetPwmHours = hourPwm;

  if (!motionProfileEnabled)
  {
    writeInstrument(1, minutePwm);
    writeInstrument(2, hourPwm);
  }

  lastDisplayedHour = dummyHour;
  lastDisplayedMinute = dummyMinute;
  Serial.printf("[UHR] %02u:%02u | Minuten PWM-Ziel %u | Stunden PWM-Ziel %u\n",
                dummyHour,
                dummyMinute,
                minutePwm,
                hourPwm);
}

void setOperatingMode(OperatingMode mode)
{
  operatingMode = mode;
  lastDisplayedHour = -1;
  lastDisplayedMinute = -1;
  if (mode == OperatingMode::Normal)
  {
    activeInstrument = 1;
    applyNormalTime();
    return;
  }

  calibrationIndex = 0;
  showCalibrationPoint();
}

void handleShortPress()
{
  if (operatingMode == OperatingMode::Normal)
    return;

  uint16_t *table = activeCalibrationTable();
  table[calibrationIndex] = static_cast<uint16_t>(constrain(rotaryEncoder.readEncoder(), 0, PWM_MAX));
  saveCalibration();
  Serial.printf("[KALIBRIERUNG] Gespeichert: %u\n", table[calibrationIndex]);

  if (operatingMode == OperatingMode::CalibrationMinutes && calibrationIndex == CALIBRATION_POINTS - 1)
    return;
  if (operatingMode == OperatingMode::CalibrationHours && calibrationIndex == CALIBRATION_POINTS - 1)
  {
    setOperatingMode(OperatingMode::Normal);
    return;
  }

  ++calibrationIndex;
  showCalibrationPoint();
}

void handleLongPress()
{
  if (operatingMode == OperatingMode::CalibrationMinutes && calibrationIndex == CALIBRATION_POINTS - 1)
  {
    setOperatingMode(OperatingMode::CalibrationHours);
    return;
  }
  if (operatingMode == OperatingMode::CalibrationHours)
    setOperatingMode(OperatingMode::Normal);
}

void handleEncoderButton()
{
  const unsigned long now = millis();
  const bool pressed = digitalRead(ENCODER_SW_PIN) == LOW;

  if (pressed != buttonWasPressed && now - buttonChangedAt >= BUTTON_DEBOUNCE_MS)
  {
    buttonWasPressed = pressed;
    buttonChangedAt = now;
    if (pressed)
    {
      buttonPressedAt = now;
      longPressHandled = false;
    }
    else if (!longPressHandled)
    {
      handleShortPress();
    }
  }

  if (pressed && !longPressHandled && now - buttonPressedAt >= BUTTON_LONG_PRESS_MS)
  {
    longPressHandled = true;
    handleLongPress();
  }
}

void handleEncoder()
{
  if (!rotaryEncoder.encoderChanged())
    return;

  const int value = constrain(rotaryEncoder.readEncoder(), 0, PWM_MAX);
  if (value == lastEncoderValue)
    return;
  lastEncoderValue = value;

  if (operatingMode == OperatingMode::Normal)
    return;

  activeCalibrationTable()[calibrationIndex] = value;
  writeInstrument(activeCalibrationInstrument(), value);
  Serial.printf("[KALIBRIERUNG] Instrument %d | PWM %d\n", activeCalibrationInstrument(), value);
}

WebServerState readWebState()
{
  WebServerState state{};
  state.mode = static_cast<uint8_t>(operatingMode);
  state.calibrationIndex = calibrationIndex;
  state.dummyHour = dummyHour;
  state.dummyMinute = dummyMinute;
  state.activeInstrument = activeInstrument;
  state.pwmMinutes = pwmMinutes;
  state.pwmHours = pwmHours;
  state.targetPwmMinutes = targetPwmMinutes;
  state.targetPwmHours = targetPwmHours;
  state.motionEnabled = motionProfileEnabled;
  state.motionIntervalMs = motionIntervalMs;
  state.motionAccel = motionAccel;
  state.motionMaxSpeed = motionMaxSpeed;
  memcpy(state.minutes, calibration.minutes, sizeof(calibration.minutes));
  memcpy(state.hours, calibration.hours, sizeof(calibration.hours));
  return state;
}

bool writeWebPwm(int instrument, int value)
{
  if ((instrument != 1 && instrument != 2) || !validPwm(value))
    return false;

  activeInstrument = instrument;
  driveInstrumentLive(instrument, value);
  rotaryEncoder.setEncoderValue(value);
  lastEncoderValue = value;
  return true;
}

bool setWebMode(uint8_t mode)
{
  if (mode > static_cast<uint8_t>(OperatingMode::CalibrationHours))
    return false;
  setOperatingMode(static_cast<OperatingMode>(mode));
  return true;
}

bool setWebTime(uint8_t hour, uint8_t minute)
{
  if (hour > 12 || minute > 59)
    return false;
  dummyHour = hour;
  dummyMinute = minute;
  preferences.putUChar("hour", dummyHour);
  preferences.putUChar("minute", dummyMinute);
  if (operatingMode == OperatingMode::Normal)
    applyNormalTime();
  return true;
}

bool writeWebCalibration(int instrument, uint8_t index, int value, bool persist)
{
  if ((instrument != 1 && instrument != 2) || index >= CALIBRATION_POINTS || !validPwm(value))
    return false;

  uint16_t *table = instrument == 1 ? calibration.minutes : calibration.hours;
  table[index] = static_cast<uint16_t>(value);
  if (persist)
    saveCalibration();

  driveInstrumentLive(instrument, value);
  if (operatingMode != OperatingMode::Normal && activeCalibrationInstrument() == instrument && calibrationIndex == index)
  {
    rotaryEncoder.setEncoderValue(value);
    lastEncoderValue = value;
  }
  return true;
}

bool saveWebCalibration()
{
  saveCalibration();
  return true;
}

bool setWebMotion(bool enabled, uint32_t intervalMs, int accel, int maxSpeed)
{
  const uint32_t clampedInterval = constrain(intervalMs, 1u, static_cast<uint32_t>(MOTION_INTERVAL_MS_MAX));
  const int clampedAccel = constrain(accel, 1, MOTION_ACCEL_MAX);
  const int clampedMaxSpeed = constrain(maxSpeed, 1, MOTION_MAX_SPEED_MAX);

  motionProfileEnabled = enabled;
  motionIntervalMs = clampedInterval;
  motionAccel = clampedAccel;
  motionMaxSpeed = clampedMaxSpeed;

  preferences.putBool("motionEn", motionProfileEnabled);
  preferences.putUInt("motionInt", clampedInterval);
  preferences.putInt("motionAcc", clampedAccel);
  preferences.putInt("motionMax", clampedMaxSpeed);
  return true;
}

void startAccessPoint()
{
  if (accessPointActive)
    return;
  WiFi.mode(WIFI_AP);
  WiFi.softAP(AP_SSID, AP_PASSWORD);
  accessPointActive = true;
  Serial.printf("Access Point '%s' gestartet, IP: %s\n", AP_SSID, WiFi.softAPIP().toString().c_str());
}

void startWifi()
{
  wifiStartTime = millis();
  WiFi.mode(WIFI_STA);
  if (strlen(WIFI_SSID) == 0)
  {
    startAccessPoint();
    return;
  }

  if (strlen(STATIC_IP) > 0)
  {
    IPAddress ip, gateway, subnet;
    if (ip.fromString(STATIC_IP) && gateway.fromString(STATIC_GATEWAY) && subnet.fromString(STATIC_SUBNET))
      WiFi.config(ip, gateway, subnet);
    else
      Serial.println("[WARNUNG] Ungueltige statische IP-Konfiguration, verwende DHCP.");
  }
  WiFi.begin(WIFI_SSID, WIFI_PASSWORD);
  lastWifiCheck = wifiStartTime;
  Serial.printf("Verbinde mit WLAN '%s' ...\n", WIFI_SSID);
}

void maintainWifi()
{
  if (accessPointActive || WiFi.status() == WL_CONNECTED)
    return;

  const unsigned long now = millis();
  if (now - wifiStartTime >= WIFI_STARTUP_TIMEOUT_MS)
  {
    startAccessPoint();
    return;
  }
  if (now - lastWifiCheck >= WIFI_RECONNECT_INTERVAL_MS)
  {
    WiFi.disconnect();
    WiFi.begin(WIFI_SSID, WIFI_PASSWORD);
    lastWifiCheck = now;
  }
}

void setup()
{
  Serial.begin(115200);
  Serial.println("\n=== Hartmann & Braun Uhr gestartet ===");

  preferences.begin("hb-uhr", false);
  initializeCalibration();
  dummyHour = preferences.getUChar("hour", 12);
  dummyMinute = preferences.getUChar("minute", 0);
  if (dummyHour > 12 || dummyMinute > 59)
  {
    dummyHour = 12;
    dummyMinute = 0;
  }

  motionProfileEnabled = preferences.getBool("motionEn", ENABLE_MOTION_PROFILE);
  motionIntervalMs = constrain(preferences.getUInt("motionInt", MOTION_INTERVAL_MS_DEFAULT), 1u, static_cast<uint32_t>(MOTION_INTERVAL_MS_MAX));
  motionAccel = constrain(preferences.getInt("motionAcc", MOTION_ACCEL_DEFAULT), 1, MOTION_ACCEL_MAX);
  motionMaxSpeed = constrain(preferences.getInt("motionMax", MOTION_MAX_SPEED_DEFAULT), 1, MOTION_MAX_SPEED_MAX);

  ledcAttach(PIN_MINUTES, PWM_FREQ, PWM_RESOLUTION);
  ledcAttach(PIN_HOURS, PWM_FREQ, PWM_RESOLUTION);
  writeInstrument(1, 0);
  writeInstrument(2, 0);

  pinMode(ENCODER_SW_PIN, INPUT_PULLUP);
  rotaryEncoder.begin();
  rotaryEncoder.setup(readEncoderISR);
  rotaryEncoder.setBoundaries(0, PWM_MAX, false);
  rotaryEncoder.setAcceleration(50);
  rotaryEncoder.setEncoderValue(0);

  startWifi();
  richteWebserverEin(readWebState, writeWebPwm, setWebMode, setWebTime, writeWebCalibration, saveWebCalibration, setWebMotion);
  applyNormalTime();
  Serial.printf("PWM-Bereich: 0..%d | Webserver bereit\n", PWM_MAX);
}

void loop()
{
  maintainWifi();
  bearbeiteWebserver();
  handleEncoderButton();
  handleEncoder();

  if (operatingMode == OperatingMode::Normal && (dummyHour != lastDisplayedHour || dummyMinute != lastDisplayedMinute))
    applyNormalTime();

  // Bewegungsprofil laeuft unabhaengig von der Betriebsart, damit Live-Ausgaben ueberall wirken.
  updateInstrumentMotion();
}